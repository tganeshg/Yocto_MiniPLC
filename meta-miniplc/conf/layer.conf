## meta-miniplc/conf/layer.conf
```bitbake
# meta-miniplc layer configuration
#
# All MiniHMI / Mini PLC product customizations live in this layer.
# meta-raspberrypi stays pristine upstream — we only override it via
# bbappends here.

# We have a conf and classes directory, add to BBPATH
BBPATH .= ":${LAYERDIR}"

# Pick up recipes and bbappends
BBFILES += "${LAYERDIR}/recipes-*/*/*.bb \
            ${LAYERDIR}/recipes-*/*/*.bbappend"

BBFILE_COLLECTIONS += "miniplc"
BBFILE_PATTERN_miniplc = "^${LAYERDIR}/"
# Higher than meta-oe (=6) and meta-raspberrypi (=9) so our overrides win.
BBFILE_PRIORITY_miniplc = "20"

LAYERDEPENDS_miniplc = "core raspberrypi openembedded-layer networking-layer webserver"
LAYERSERIES_COMPAT_miniplc = "kirkstone"

# Layer version — bump when releasing changes that break compatibility.
LAYERVERSION_miniplc = "1"
```
